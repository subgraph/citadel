## meta-citadel-distro/conf/distro/citadel-distro.conf
```bitbake
DISTRO = "citadel-distro"
DISTRO_NAME = "Subgraph OS Citadel"
DISTRO_VERSION = "1.0"

CITADEL_DEFAULT_DISTRO_FEATURES = "largefile systemd"
DISTRO_FEATURES ?= "${DISTRO_FEATURES_DEFAULT} ${DISTRO_FEATURES_LIBC} ${CITADEL_DEFAULT_DISTRO_FEATURES}"

#
# Use systemd for system initialization
#
VIRTUAL-RUNTIME_init_manager = "systemd"
VIRTUAL-RUNTIME_initscripts = ""
VIRTUAL-RUNTIME_initscripts = "systemd-compat-units"
DISTRO_FEATURES_BACKFILL_CONSIDERED += "sysvinit"

PREFERRED_PROVIDER_virtual/kernel = "linux-citadel"

PACKAGE_CLASSES ?= "package_deb"

INITRAMFS_IMAGE_BUNDLE = "1"
INITRAMFS_IMAGE = "citadel-initramfs"

NOISO = "1"
EFI_PROVIDER = "systemd-boot"
IMAGE_FSTYPES = "wic"
IMAGE_FEATURES = "read-only-rootfs"

GLIBC_SPLIT_LC_PACKAGES = "0"
IMAGE_LINGUAS = "en-us"

BUILD_REPRODUCIBLE_BINARIES = "1"

IMAGE_CLASSES += "qemuboot"
QB_NET = "none"
QB_MEM = "-m 1024"
QB_DEFAULT_FSTYPE = "wic"

require conf/distro/include/security_flags.inc
```

## meta-citadel-distro/conf/layer.conf
```bitbake
# We have a conf and classes directory, add to BBPATH
BBPATH =. "${LAYERDIR}:"

# We have recipes-* directories, add to BBFILES
BBFILES += "${LAYERDIR}/recipes-*/*/*.bb \
            ${LAYERDIR}/recipes-*/*/*.bbappend"

BBFILE_COLLECTIONS += "citadeldist"
BBFILE_PATTERN_citadeldist = "^${LAYERDIR}/"
BBFILE_PRIORITY_citadeldist = "5"

LAYERSERIES_COMPAT_citadeldist = "rocko"

# This should only be incremented on significant changes that will
# cause compatibility issues with other layers
LAYERVERSION_citadel = "1"

REQUIRED_POKY_BBLAYERS_CONF_VERSION = "2"
```

## meta-citadel-distro/wic/citadel-image-minimal.wks
```
part /boot --source bootimg-efi --sourceparams="loader=systemd-boot" --size=64 --fstype=vfat --label boot --active --align 1024 --use-uuid
part / --source rootfs --fstype=ext4 --label rootfs --align 1024 --use-uuid 
part /storage --fstype=ext4 --label storage --size=16 --use-uuid
bootloader --ptable gpt --timeout=5 --append="add_efi_memmap intel_iommu=igfx_off cryptomgr.notests rcupdate.rcu_expedited=1 rcu_nocbs=0-64 tsc=reliable no_timer_check noreplace-smp i915.fastboot=1 quiet splash" 
```

## meta-citadel/conf/distro/citadel-distro.conf
```bitbake
DISTRO = "citadel-distro"
DISTRO_NAME = "Subgraph OS Citadel"
DISTRO_VERSION = "1.0"

CITADEL_DEFAULT_DISTRO_FEATURES = "acl alsa argp bluetooth ext2 largefile systemd usbhost wifi xattr pci x11 usrmerge wayland opengl pam"
DISTRO_FEATURES ?= "${DISTRO_FEATURES_LIBC} ${CITADEL_DEFAULT_DISTRO_FEATURES}"


HOSTTOOLS_NONFATAL += "inkscape"
#
# Use systemd for system initialization
#
VIRTUAL-RUNTIME_init_manager = "systemd"
VIRTUAL-RUNTIME_initscripts = ""
VIRTUAL-RUNTIME_initscripts = "systemd-compat-units"
DISTRO_FEATURES_BACKFILL_CONSIDERED += "sysvinit"

PREFERRED_PROVIDER_virtual/kernel = "citadel-kernel"

PACKAGE_CLASSES ?= "package_deb"

FILESYSTEM_PERMS_TABLES = "files/citadel-fs-perms.txt"

INITRAMFS_IMAGE_BUNDLE = "1"
INITRAMFS_IMAGE = "citadel-initramfs-image"

NOISO = "1"
EFI_PROVIDER = "systemd-boot"
IMAGE_FSTYPES = "ext2"
IMAGE_FEATURES = "read-only-rootfs"

GLIBC_SPLIT_LC_PACKAGES = "0"
GLIBC_GENERATE_LOCALES = "en_US.UTF-8"
IMAGE_LINGUAS = "en-us"

BUILD_REPRODUCIBLE_BINARIES = "1"

INHERIT += "reproducible_build"

# Override meta-rust dependencies.
#
# Instead of bringing in all of openembedded, we imported the two recipes
# meta-rust depends on:
#
#        meta-citadel/recipes-support/libgit2/
#        meta-citadel/recipes-support/libssh2/
#
LAYERDEPENDS_rust-layer = "core"

require conf/distro/include/security_flags.inc
```

## meta-citadel/conf/layer.conf
```bitbake
# We have a conf and classes directory, add to BBPATH
BBPATH =. "${LAYERDIR}:"

# We have recipes-* directories, add to BBFILES
BBFILES += "${LAYERDIR}/recipes-*/*/*.bb \
            ${LAYERDIR}/recipes-*/*/*.bbappend"

LICENSE_PATH += "${LAYERDIR}/licenses"

BBFILE_COLLECTIONS += "citadel"
BBFILE_PATTERN_citadel = "^${LAYERDIR}/"
BBFILE_PRIORITY_citadel = "5"

LAYERSERIES_COMPAT_citadel = "sumo"

# This should only be incremented on significant changes that will
# cause compatibility issues with other layers
LAYERVERSION_citadel = "1"

REQUIRED_POKY_BBLAYERS_CONF_VERSION = "2"
```

## meta-gnome/conf/layer.conf
```bitbake
# We have a conf and classes directory, add to BBPATH
BBPATH .= ":${LAYERDIR}"

LAYERSERIES_COMPAT_meta-gnome = "thud"

# We have recipes-* directories, add to BBFILES
BBFILES += "${LAYERDIR}/recipes-*/*/*.bb \
            ${LAYERDIR}/recipes-*/*/*.bbappend"

BBFILE_COLLECTIONS += "meta-gnome"
BBFILE_PATTERN_meta-gnome = "^${LAYERDIR}/"
BBFILE_PRIORITY_meta-gnome = "6"
```
